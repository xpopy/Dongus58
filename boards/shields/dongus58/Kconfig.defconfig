## boards/shields/dongus58/Kconfig.defconfig
```kconfig
# Copyright (c) 2022 The ZMK Contributors
# SPDX-License-Identifier: MIT

if SHIELD_DONGUS58_DONGLE

config ZMK_KEYBOARD_NAME
	default "Dongus58 Dongle"
	
config ZMK_SPLIT_BLE_ROLE_CENTRAL
	default y
	
config ZMK_USB
	default y

endif

if SHIELD_DONGUS58_LEFT || SHIELD_DONGUS58_RIGHT || SHIELD_DONGUS58_DONGLE 

config ZMK_SPLIT
	default y

config ZMK_BLE
	default y
	
endif
```

## boards/shields/dongus58/Kconfig.sheild
```kconfig
# Copyright (c) 2022 The ZMK Contributors
# SPDX-License-Identifier: MIT

config SHIELD_DONGUS58_LEFT
    def_bool $(shields_list_contains,dongus58_left)

config SHIELD_DONGUS58_RIGHT
    def_bool $(shields_list_contains,dongus58_right)

config SHIELD_DONGUS58_DONGLE
	def_bool $(shields_list_contains,dongus58_dongle)
```

## config/Kconfig.defconfig
```kconfig
# Copyright (c) 2022 The ZMK Contributors
# SPDX-License-Identifier: MIT

if SHIELD_LOTUS58_DONGLE

config ZMK_KEYBOARD_NAME
	default "Lotus58 Dongle"
	
config ZMK_SPLIT_BLE_ROLE_CENTRAL
	default y
	
config ZMK_USB
	default y

endif

if SHIELD_LOTUS58_LEFT || SHIELD_LOTUS58_RIGHT || SHIELD_LOTUS58_DONGLE 

config ZMK_SPLIT
	default y

config ZMK_BLE
	default y
	
endif
```
